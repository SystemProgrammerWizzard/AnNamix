## conf/distro/anamix.conf
```bitbake
DISTRO_NAME = "Anamix Linux"
DISTRO_VERSION = "1.0"


DISTRO_FEATURES:append = " systemd pam x11 wayland opengl kde polkit"
VIRTUAL-RUNTIME_init_manager = "systemd"
DISTRO_FEATURES_BACKFILL_CONSIDERED = "sysvinit"
VIRTUAL-RUNTIME_initscripts = ""

# Set RPM as the package format
PACKAGE_CLASSES = "package_rpm"

# Enable package-management utilities in image
EXTRA_IMAGE_FEATURES += "package-management"

PREFERRED_PROVIDER_virtual/libgl = "mesa"
# Enable DNF support
IMAGE_INSTALL:append = " dnf rpm"

# Automatically configure DNF repo
USE_DEPMOD = "1"

LICENSE_FLAGS_ACCEPTED:append = " commercial ffmpeg"
```
